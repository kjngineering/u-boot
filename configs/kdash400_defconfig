## configs/kdash400_defconfig
```kconfig
CONFIG_ARM=y
CONFIG_ARCH_SUNXI=y
CONFIG_DEFAULT_DEVICE_TREE="sun8i-t113s-kdash-400"
CONFIG_SPL=y
CONFIG_DRAM_SUNXI_ODT_EN=0
CONFIG_DRAM_SUNXI_TPR0=0x004a2195
CONFIG_DRAM_SUNXI_TPR11=0x340000
CONFIG_DRAM_SUNXI_TPR12=0x46
CONFIG_MACH_SUN8I_R528=y
CONFIG_DRAM_CLK=792
CONFIG_DRAM_ZQ=8092667
CONFIG_SUNXI_MINIMUM_DRAM_MB=128
# CONFIG_SYS_MALLOC_CLEAR_ON_INIT is not set
CONFIG_BOOTDELAY=1
CONFIG_USE_BOOTCOMMAND=y
CONFIG_BOOTCOMMAND="run bootcmd_slot"
CONFIG_BUTTON=y
CONFIG_BUTTON_GPIO=y
CONFIG_BUTTON_CMD=y
CONFIG_CMD_BUTTON=y
CONFIG_CMD_USB_MASS_STORAGE=y
CONFIG_NO_NET=y
CONFIG_DRAM_SUNXI_TPR13=0x34000100
CONFIG_CONS_INDEX=4
CONFIG_MMC_SUNXI_SLOT_EXTRA=2
# Persistent environment on eMMC (dev 1, raw at 960KB / 0xF0000, 128KB, redundant copy at 1MB+64KB)
# CONFIG_ENV_IS_IN_FAT is not set
CONFIG_ENV_IS_IN_MMC=y
CONFIG_SYS_MMC_ENV_DEV=1
CONFIG_SYS_REDUNDAND_ENVIRONMENT=y
CONFIG_ENV_OFFSET=0xF0000
CONFIG_ENV_OFFSET_REDUND=0x110000
CONFIG_ENV_SIZE=0x20000
CONFIG_DM_USB_GADGET=y
CONFIG_USB_MUSB_GADGET=y
CONFIG_LED=y
CONFIG_LED_GPIO=y
```
